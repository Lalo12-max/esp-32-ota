## main/Kconfig.projbuild
```kconfig
menu "Example Configuration"

    config EXAMPLE_FIRMWARE_UPGRADE_URL
        string "Firmware upgrade URL"
        default "http://192.168.1.100:8000/firmware/esp32_ota_firmware.bin"
        help
            URL of server which hosts the firmware image.

endmenu
```
